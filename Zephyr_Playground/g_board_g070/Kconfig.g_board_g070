## Zephyr_Playground/g_board_g070/Kconfig.g_board_g070
```kconfig
# Copyright (c) 2023 Marin Jurjević <marin.jurjevic@hotmail.com>
# SPDX-License-Identifier: Apache-2.0

config BOARD_G_BOARD_G070
	select SOC_STM32G070XX
```

## Zephyr_Playground/g_board_g070/board.yml
```yaml
board:
  name: g_board_g070
  full_name: G-Board-G070
  vendor: db
  socs:
    - name: stm32g070xx
```
